## br-external/Config.in
```kconfig
source "$BR2_EXTERNAL_PURITAN_PATH/package/puredata/Config.in"
source "$BR2_EXTERNAL_PURITAN_PATH/package/disis_spi/Config.in"
```

## br-external/configs/puritan_defconfig
```kconfig
BR2_arm=y
BR2_arm1176jzf_s=y
BR2_CCACHE=y
BR2_ENABLE_DEBUG=y
BR2_STRIP_EXCLUDE_FILES="pd pd-gui wish8.6"
BR2_OPTIMIZE_G=y
BR2_KERNEL_HEADERS_4_14=y
BR2_TOOLCHAIN_BUILDROOT_WCHAR=y
BR2_PTHREAD_DEBUG=y
BR2_TOOLCHAIN_BUILDROOT_CXX=y
BR2_TARGET_GENERIC_HOSTNAME="puritan"
BR2_ROOTFS_DEVICE_TABLE="../br-external/board/device_table.txt"
BR2_TARGET_GENERIC_ROOT_PASSWD="password"
# BR2_TARGET_GENERIC_REMOUNT_ROOTFS_RW is not set
BR2_ROOTFS_USERS_TABLES="../br-external/board/users.config"
BR2_ROOTFS_OVERLAY="../br-external/board/rootfs_overlay"
BR2_ROOTFS_POST_BUILD_SCRIPT="../br-external/board/post-build.sh"
BR2_ROOTFS_POST_IMAGE_SCRIPT="../br-external/board/post-image.sh"
BR2_ROOTFS_POST_SCRIPT_ARGS="--add-pi3-miniuart-bt-overlay"
BR2_LINUX_KERNEL=y
BR2_LINUX_KERNEL_CUSTOM_GIT=y
BR2_LINUX_KERNEL_CUSTOM_REPO_URL="https://github.com/raspberrypi/linux"
BR2_LINUX_KERNEL_CUSTOM_REPO_VERSION="rpi-4.18.y"
BR2_LINUX_KERNEL_USE_CUSTOM_CONFIG=y
BR2_LINUX_KERNEL_CUSTOM_CONFIG_FILE="../br-external/configs/kernel_config"
BR2_LINUX_KERNEL_DTS_SUPPORT=y
BR2_LINUX_KERNEL_INTREE_DTS_NAME="bcm2708-rpi-0-w"
BR2_PACKAGE_ALSA_UTILS=y
BR2_PACKAGE_ALSA_UTILS_AMIDI=y
BR2_PACKAGE_ALSA_UTILS_APLAY=y
BR2_PACKAGE_ALSA_UTILS_ASEQDUMP=y
BR2_PACKAGE_ALSA_UTILS_SPEAKER_TEST=y
BR2_PACKAGE_SOX=y
BR2_PACKAGE_GDB=y
BR2_PACKAGE_GDB_DEBUGGER=y
BR2_PACKAGE_GDB_TUI=y
BR2_PACKAGE_SPIDEV_TEST=y
BR2_PACKAGE_DEJAVU=y
BR2_PACKAGE_TK=y
BR2_PACKAGE_XORG7=y
BR2_PACKAGE_XCB_UTIL_IMAGE=y
BR2_PACKAGE_XLIB_LIBXI=y
BR2_PACKAGE_XLIB_LIBXV=y
BR2_PACKAGE_XAPP_XAUTH=y
BR2_PACKAGE_XAPP_XEYES=y
BR2_PACKAGE_XFONT_ENCODINGS=y
BR2_PACKAGE_RPI_FIRMWARE=y
BR2_PACKAGE_RPI_FIRMWARE_X=y
BR2_PACKAGE_RPI_WIFI_FIRMWARE=y
BR2_PACKAGE_RNG_TOOLS=y
BR2_PACKAGE_PYTHON3=y
BR2_PACKAGE_DNSMASQ=y
BR2_PACKAGE_OPENSSH=y
BR2_PACKAGE_WPA_SUPPLICANT=y
BR2_PACKAGE_WPA_SUPPLICANT_AP_SUPPORT=y
BR2_PACKAGE_WPA_SUPPLICANT_AUTOSCAN=y
BR2_PACKAGE_WPA_SUPPLICANT_DEBUG_SYSLOG=y
BR2_PACKAGE_WPA_SUPPLICANT_WPS=y
BR2_PACKAGE_WPA_SUPPLICANT_CLI=y
BR2_PACKAGE_WPA_SUPPLICANT_WPA_CLIENT_SO=y
BR2_PACKAGE_SUDO=y
BR2_PACKAGE_NANO=y
BR2_TARGET_ROOTFS_SQUASHFS=y
# BR2_TARGET_ROOTFS_TAR is not set
BR2_PACKAGE_HOST_DOSFSTOOLS=y
BR2_PACKAGE_HOST_E2FSPROGS=y
BR2_PACKAGE_HOST_GENIMAGE=y
BR2_PACKAGE_HOST_MTOOLS=y
BR2_PACKAGE_PUREDATA=y
BR2_PACKAGE_DISIS_SPI=y
```

## br-external/configs/tpt6_defconfig
```kconfig
BR2_arm=y
BR2_arm1176jzf_s=y
BR2_CCACHE=y
BR2_KERNEL_HEADERS_4_4=y
BR2_TOOLCHAIN_BUILDROOT_CXX=y
BR2_ROOTFS_DEVICE_CREATION_DYNAMIC_MDEV=y
BR2_ROOTFS_USERS_TABLES="../br-external/board/users.config"
BR2_ROOTFS_OVERLAY="../br-external/board/rootfs_overlay"
BR2_ROOTFS_POST_BUILD_SCRIPT="board/raspberrypi0w/post-build.sh"
BR2_ROOTFS_POST_IMAGE_SCRIPT="board/raspberrypi0w/post-image.sh"
BR2_ROOTFS_POST_SCRIPT_ARGS="--add-pi3-miniuart-bt-overlay"
BR2_LINUX_KERNEL=y
BR2_LINUX_KERNEL_CUSTOM_GIT=y
BR2_LINUX_KERNEL_CUSTOM_REPO_URL="https://github.com/raspberrypi/linux"
BR2_LINUX_KERNEL_CUSTOM_REPO_VERSION="rpi-4.4.y"
BR2_LINUX_KERNEL_DEFCONFIG="bcmrpi"
BR2_LINUX_KERNEL_DTS_SUPPORT=y
BR2_LINUX_KERNEL_INTREE_DTS_NAME="bcm2708-rpi-0-w"
BR2_PACKAGE_RPI_FIRMWARE=y
BR2_PACKAGE_RPI_WIFI_FIRMWARE=y
BR2_PACKAGE_DNSMASQ=y
BR2_PACKAGE_OPENSSH=y
BR2_PACKAGE_WPA_SUPPLICANT=y
BR2_PACKAGE_WPA_SUPPLICANT_AP_SUPPORT=y
BR2_TARGET_ROOTFS_EXT2=y
BR2_TARGET_ROOTFS_EXT2_4=y
BR2_TARGET_ROOTFS_EXT2_SIZE="80M"
# BR2_TARGET_ROOTFS_TAR is not set
BR2_PACKAGE_HOST_DOSFSTOOLS=y
BR2_PACKAGE_HOST_GENIMAGE=y
BR2_PACKAGE_HOST_MTOOLS=y
```

## br-external/package/disis_spi/Config.in
```kconfig
config BR2_PACKAGE_DISIS_SPI
	bool "disis_spi"
	select BR2_PACKAGE_WIRINGPI
	depends on BR2_PACKAGE_PUREDATA
	help
	  MCP3008 interface for Pure Data on Raspberry Pi.

	  http://wiringpi.com/
```

## br-external/package/puredata/Config.in
```kconfig
config BR2_PACKAGE_PUREDATA
	bool "puredata"
	help
	  Pure Data (or just Pd) is an open source visual programming 
	  language for multimedia.

	  https://puredata.info/

if BR2_PACKAGE_PUREDATA 
	source "package/puredata/pd-wiringpi/Config.in"
endif
```

## br-external/package/puredata/pd-wiringpi/Config.in
```kconfig
config BR2_PACKAGE_PUREDATA_PDWIRINGPI
	bool "pd-wiringpi"
	select BR2_PACKAGE_WIRINGPI
	help
	  Wiring Pi external for Pure Data

	  http://wiringpi.com/
```
